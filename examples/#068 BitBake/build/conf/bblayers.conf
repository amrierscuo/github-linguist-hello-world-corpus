## examples/#068 BitBake/meta-hello/conf/layer.conf
```bitbake
BBPATH .= ":${LAYERDIR}"
BBFILES += "${LAYERDIR}/*.bb"
BBFILE_COLLECTIONS += "corpushello"
BBFILE_PATTERN_corpushello := "^${LAYERDIR}/"
BBFILE_PRIORITY_corpushello = "1"
```
